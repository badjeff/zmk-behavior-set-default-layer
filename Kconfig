## Kconfig
```kconfig
# Sensor data simulator
#
# Copyright (c) 2019 Nordic Semiconductor
#
# SPDX-License-Identifier: LicenseRef-Nordic-5-Clause
#

DT_COMPAT_ZMK_BEHAVIOR_SET_DEFAULT_LAYER := zmk,behavior-set-default-layer

config ZMK_BEHAVIOR_SET_DEFAULT_LAYER
		bool
		default $(dt_compat_enabled,$(DT_COMPAT_ZMK_BEHAVIOR_SET_DEFAULT_LAYER))
```

## dts/bindings/zmk,behavior-set-default-layer.yaml
```yaml
# Copyright (c) 2024 The ZMK Contributors
# SPDX-License-Identifier: MIT

description: Set Default Layer Behavior

compatible: "zmk,behavior-set-default-layer"

include: one_param.yaml
```
